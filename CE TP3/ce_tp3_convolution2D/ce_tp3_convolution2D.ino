#include <Adafruit_SSD1306.h>

#define WIDTH 64
#define HEIGHT 64
#define KERNEL_SIZE 3

// Définition du kernel de convolution
int kernel[KERNEL_SIZE][KERNEL_SIZE] = {
  {0, 0, 0},
  {2, 2, 2},
  {0, 0, 0}
};

// Définition de l'image d'entrée
int image[HEIGHT][WIDTH]=
{{0,0,0,0,0,0,0,0,0,0,0,0,0,0,0,0,0,0,0,0,0,0,0,0,0,0,0,0,0,0,0,0,0,0,0,0,0,0,0,0,0,0,0,0,0,0,0,0,0,0,0,0,0,0,0,0,0,0,0,0,0,0,0,0},
{0,0,0,0,0,0,0,0,0,0,0,0,0,0,0,0,0,0,0,0,0,0,0,0,0,0,0,0,0,0,0,0,0,0,0,0,0,0,0,0,0,0,0,0,0,0,0,0,0,0,0,0,0,0,0,0,0,0,0,0,0,0,0,0},
{0,0,0,0,0,0,0,0,0,0,0,0,0,0,0,0,0,0,0,0,0,0,0,0,0,0,0,0,0,0,0,0,0,0,0,0,0,0,0,0,0,0,0,0,0,0,0,0,0,0,0,0,0,0,0,0,0,0,0,0,0,0,0,0},
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{0,0,0,0,0,0,0,0,0,0,0,0,0,0,0,0,0,0,0,0,0,0,0,0,0,0,0,0,0,0,0,0,0,0,0,0,0,0,0,0,0,0,0,0,0,0,0,0,0,0,0,0,0,0,0,0,0,0,0,0,0,0,0,0}
};

// Définition de l'image de sortie
int output[HEIGHT][WIDTH];

// Initialisation de l'écran OLED
Adafruit_SSD1306 display(WIDTH+64, HEIGHT, &Wire, -1);

void setup() {
  // Initialisation de l'écran OLED
  display.begin(SSD1306_SWITCHCAPVCC, 0x3C);
  display.clearDisplay();
  display.display();

  // Initialisation de l'image d'entrée
  // (à remplir avec les valeurs de l'image à traiter)

// Définition du tableau pour l'image du cœur



}
int x,y;

void loop() {
    display.clearDisplay();
  display.display();
  // Calcul de la convolution
  for (int i = 0; i < HEIGHT; i++) {
    for (int j = 0; j < WIDTH; j++) {
      int sum = 0;
      for (int k = -KERNEL_SIZE/2; k <= KERNEL_SIZE/2; k++) {
        for (int l = -KERNEL_SIZE/2; l <= KERNEL_SIZE/2; l++) {
          x = j + l;
          y = i + k;
          if (x >= 0 && x < WIDTH && y >= 0 && y < HEIGHT) {
            sum += kernel[l + KERNEL_SIZE/2][k + KERNEL_SIZE/2] * image[y][x];
          }
        }
      }
      output[i][j] = sum;
    }
  }

  // Affichage de l'image de sortie sur l'écran OLED
  for (int i = 0; i < HEIGHT; i++) {
    for (int j = 0; j < WIDTH; j++) {
      if (output[i][j] > 255) output[i][j] = 1;
      if (output[i][j] < 0) output[i][j] = 0;
      display.drawPixel(j, i, output[i][j]);
      display.drawPixel(j+64, i, image[i][j]);
    }
  }
  display.display();

  // Attente avant la prochaine itération
  delay(1000);
}